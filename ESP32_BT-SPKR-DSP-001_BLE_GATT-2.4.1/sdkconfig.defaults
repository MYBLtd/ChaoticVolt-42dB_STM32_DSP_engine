## ESP32_BT-SPKR-DSP-001_BLE_GATT-2.4.1/sdkconfig.defaults
```kconfig
# ESP32 Bluetooth Speaker - SDK Configuration Defaults
# For ESP-IDF v6.0-beta1 or later
# FSD-DSP-001: A2DP audio + BLE GATT control

# Target: ESP32-WROOM-32
CONFIG_IDF_TARGET="esp32"

# Serial flasher config
CONFIG_ESPTOOLPY_FLASHSIZE_4MB=y
CONFIG_ESPTOOLPY_FLASHFREQ_40M=y

# Partition table - Custom OTA partition layout
CONFIG_PARTITION_TABLE_CUSTOM=y
CONFIG_PARTITION_TABLE_CUSTOM_FILENAME="partitions_ota.csv"

# OTA Configuration
CONFIG_BOOTLOADER_APP_ROLLBACK_ENABLE=y
CONFIG_ESP_HTTPS_OTA_ALLOW_HTTP=y

# Bluetooth Controller Configuration - Dual Mode (Classic BT + BLE)
CONFIG_BTDM_CTRL_MODE_BTDM=y
CONFIG_BTDM_CTRL_BR_EDR_MAX_ACL_CONN=2
CONFIG_BTDM_CTRL_BR_EDR_MAX_SYNC_CONN=0
CONFIG_BTDM_CTRL_BLE_MAX_CONN=3
CONFIG_BTDM_CTRL_MODEM_SLEEP=n

# Bluetooth Host Configuration
CONFIG_BT_ENABLED=y
CONFIG_BT_BLUEDROID_ENABLED=y
CONFIG_BT_CLASSIC_ENABLED=y
CONFIG_BT_A2DP_ENABLE=y
CONFIG_BT_SPP_ENABLED=n
CONFIG_BT_HFP_ENABLE=n
CONFIG_BT_BLE_ENABLED=y

# BLE GATT Configuration
CONFIG_BT_GATTS_ENABLE=y
CONFIG_BT_GATTC_ENABLE=n
CONFIG_BT_BLE_42_FEATURES_SUPPORTED=y

# FreeRTOS settings
CONFIG_FREERTOS_HZ=1000

# Task Watchdog
CONFIG_ESP_TASK_WDT_EN=y
CONFIG_ESP_TASK_WDT_INIT=y
CONFIG_ESP_TASK_WDT_TIMEOUT_S=30
CONFIG_ESP_TASK_WDT_CHECK_IDLE_TASK_CPU0=n
CONFIG_ESP_TASK_WDT_CHECK_IDLE_TASK_CPU1=n

# System settings
CONFIG_ESP_SYSTEM_PANIC_PRINT_REBOOT=y

# Log level
CONFIG_LOG_DEFAULT_LEVEL_INFO=y
CONFIG_LOG_DEFAULT_LEVEL=3

# Console UART settings
CONFIG_ESP_CONSOLE_UART_DEFAULT=y

# Optimization
CONFIG_COMPILER_OPTIMIZATION_PERF=y
```
